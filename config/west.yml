## config/west.yml
```yaml
manifest:
  remotes:
    - name: zmkfirmware
      url-base: https://github.com/zmkfirmware
    # Additional modules containing boards/shields/custom code can be listed here as well
    # See https://docs.zephyrproject.org/3.2.0/develop/west/manifest.html#projects
    - name: rschenk
      url-base: https://github.com/rschenk
    - name: carrefinho
      url-base: https://github.com/carrefinho

  projects:
    - name: zmk
      remote: zmkfirmware
      revision: main
      import: app/west.yml

    # Raytac MDBT50Q
    - name: zmk-component-raytac-dongle
      remote: rschenk
      revision: v0.4

    # Prospector dongle
    - name: prospector-zmk-module
      remote: carrefinho

  self:
    path: config
```
