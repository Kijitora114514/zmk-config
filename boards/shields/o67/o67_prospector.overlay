// This file was generated from a template. Edit it to match your keyboard.
// See https://zmk.dev/docs/development/hardware-integration/new-shield for more
// instructions.

#include "o67.dtsi"

&kscan {
    compatible = "zmk,kscan-gpio-direct";
    //wakeup-source;
    input-gpios
        = <&gpio0 11 (GPIO_PULL_UP | GPIO_ACTIVE_LOW)> // toggle
        , <&gpio0 12 (GPIO_PULL_UP | GPIO_ACTIVE_LOW)> // white
        , <&gpio0 13 (GPIO_PULL_UP | GPIO_ACTIVE_LOW)> // unlock
        , <&gpio0 14 (GPIO_PULL_UP | GPIO_ACTIVE_LOW)> // hui
        , <&gpio0 15 (GPIO_PULL_UP | GPIO_ACTIVE_LOW)> // fullcolor
        ;
};

