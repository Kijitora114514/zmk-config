## boards/shields/o67/Kconfig.defconfig
```kconfig
if SHIELD_O67_DONGLE || SHIELD_O67_USB_DONGLE || SHIELD_O67_LEFT_CENTRAL

config ZMK_KEYBOARD_NAME
    default "o67"

config ZMK_SPLIT_ROLE_CENTRAL
    default y

endif # SHIELD_O67_DONGLE

if SHIELD_O67_DONGLE || SHIELD_O67_USB_DONGLE || SHIELD_O67_LEFT_CENTRAL || SHIELD_O67_LEFT || SHIELD_O67_RIGHT

config ZMK_SPLIT
    default y

endif # SHIELD_O67_DONGLE || SHIELD_O67_USB_DONGLE || SHIELD_O67_LEFT_CENTRAL || SHIELD_O67_LEFT || SHIELD_O67_RIGHT
```

## boards/shields/o67/Kconfig.shield
```kconfig
config SHIELD_O67_DONGLE
    def_bool $(shields_list_contains,o67_dongle)

config SHIELD_O67_USB_DONGLE
    def_bool $(shields_list_contains,o67_usb_dongle)

config SHIELD_O67_LEFT_CENTRAL
    def_bool $(shields_list_contains,o67_left_central)

config SHIELD_O67_LEFT
    def_bool $(shields_list_contains,o67_left)

config SHIELD_O67_RIGHT
    def_bool $(shields_list_contains,o67_right)
```
