// This file was generated from a template. Edit it to match your keyboard.
// See https://zmk.dev/docs/development/hardware-integration/new-shield for more
// instructions.

#include "test.dtsi"

&kscan {
    /*
    compatible = "zmk,kscan-gpio-matrix";
    // Replace these comments with the GPIO pins in the matrix for the left side.
    // See https://zmk.dev/docs/development/hardware-integration/new-shield#shield-overlays
    col-gpios
        // = <&xiao_d 2 GPIO_ACTIVE_HIGH>
        // , <&xiao_d 3 GPIO_ACTIVE_HIGH>
        = <&gpio0 29 (GPIO_ACTIVE_HIGH | GPIO_PULL_DOWN)> //Col0
        , <&gpio0 04 (GPIO_ACTIVE_HIGH | GPIO_PULL_DOWN)> //Col1
        ;
    row-gpios
        // = <&xiao_d 0 (GPIO_ACTIVE_HIGH | GPIO_PULL_DOWN)>
        // , <&xiao_d 1 (GPIO_ACTIVE_HIGH | GPIO_PULL_DOWN)>
        = <&gpio0 02 (GPIO_ACTIVE_HIGH | GPIO_PULL_DOWN)>
        , <&gpio0 03 (GPIO_ACTIVE_HIGH | GPIO_PULL_DOWN)>
        ;
    */
    compatible = "zmk,kscan-gpio-direct";
    diode-direction = "col2row";
    input-gpios = 
        , <&gpio0 29 (GPIO_ACTIVE_HIGH | GPIO_PULL_DOWN)>
        , <&gpio0 02 (GPIO_ACTIVE_HIGH | GPIO_PULL_DOWN)>
        , <&gpio0 03 (GPIO_ACTIVE_HIGH | GPIO_PULL_DOWN)>
        , <&gpio0 04 (GPIO_ACTIVE_HIGH | GPIO_PULL_DOWN)>
        ;
    wakeup-source;
};
